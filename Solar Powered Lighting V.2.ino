#include<EEPROM.h> 
#include <avr/pgmspace.h>


//Solar Parameters obtained from simulated sensor, write them into EEPROM

const float time_sec[] PROGMEM = {0,60,120,180,240,300,360,420,480,540,600,660,720,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86340,86400};
const float solar_gen_jan[] PROGMEM = {0,20.22,35.56,50.66,40.77,0,0,0,0,0,0,0,0,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0,0};
const float solar_gen_feb[] PROGMEM = {0,0,0,2,3,4,0,0,0,0,0,0,0,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0,0};
const float solar_gen_july[] PROGMEM = {0,0,5,6,7,0,0,0,0,0,0,0,0,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0,0};
const float solar_gen_sep[] PROGMEM = {0,0,0,0,8,9,10,0,0,0,0,0,0,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0,0};
const float solar_gen_oct[] PROGMEM = {0,0,0,0,11,12,13,14,0,0,0,0,0,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0,0};

//---------------------------------------------------------------------------------

// Calculate the size of Solar parameter arrays

int time_sec_size = sizeof(time_sec)/sizeof(time_sec[0]);
int solar_gen_jan_size = sizeof(solar_gen_jan)/sizeof(solar_gen_jan[0]);
int solar_gen_feb_size = sizeof(solar_gen_feb)/sizeof(solar_gen_feb[0]);
int solar_gen_july_size = sizeof(solar_gen_july)/sizeof(solar_gen_july[0]);
int solar_gen_sep_size = sizeof(solar_gen_sep)/sizeof(solar_gen_sep[0]);
int solar_gen_oct_size = sizeof(solar_gen_oct)/sizeof(solar_gen_oct[0]);

//----------------------------------------------------------------------------------

//Define Battery Parameters, Battery chosen in this project is PowerPSSonic PS-6100 6V 12 Ah, their parameters are list below

float v_batt = 6;
float chargeCurr_max = 24; 
float C1_chargeCurr = 12;
float dischargeCurr_max = 24; 


const float time_dis[] PROGMEM = {1,2,3,5,6,8,10,15,20,30,32,40,60,70,80,120,150,180,210,300,450,600,900,1200};  //Battery discharging time in minutes  
const float vol_c20[] PROGMEM ={12.9,12.9,12.9,12.9,12.9,12.9,12.9,12.9,12.9,12.8,12.8,12.8,12.8,12.8,12.8,12.6,12.6,12.6,12.5,12.5,12.3,12.2,11.6,10.8};
const float vol_c10[] PROGMEM  ={12.8,12.8,12.8,12.8,12.8,12.8,12.8,12.7,12.7,12.6,12.6,12.6,12.5,12.5,12.5,12.4,12.3,12.3,12.2,12.1,11.7,11,10.5,0};
const float vol_c4[] PROGMEM  ={12.4,12.4,12.4,12.4,12.4,12.4,12.3,12.3,12.3,12.3,12.2,12.2,12.2,12.1,12,11.9,11.6,11.2,10.4,0,0,0,0,0};
const float vol_c125[] PROGMEM  ={12.3,12.3,12.3,12.3,12.2,12.2,12.2,12.1,12.1,12,11.7,11.5,11.3,11,8.4,0,0,0,0,0,0,0,0,0};
const float vol_1c[] PROGMEM ={12.2,12.2,12.1,12.1,12.05,12.05,12,11.7,11.6,11,10.8,7.9,0,0,0,0,0,0,0,0,0,0,0,0};
const float vol_2c[] PROGMEM ={11.8,11.8,11.7,11.6,11.5,11.3,11.2,11.7,11.6,11,10.8,7.9,0,0,0,0,0,0,0,0,0,0,0,0};
const float vol_3c[] PROGMEM ={11.5,11.4,11.3,11,10.9,7.8,0,0,0,0,0,0,0,0,0,0,0,0,0,0,0,0,0};

//----------------------------------------------------------------------------------------------------------------------------------------------

//Define LED lamp parameter, Battery chosen in this project is 12v LED 120 Watt

float p_lamp = 120;

//-----------------------------------------------------------------------------------------------------------------------------------------------

//Initialize battery parameter

float soc_batt = 1;
float soh_batt = 1;
float dod_batt = 0;

float chargeCurr = 0;
float dischargeCurr = 0;
 
int chargeFlag = 0;
int dischargeFlag = 0;
int errorFlag = 0;    

//------------------------------------------------------------------------------------------------------------------------------------------------
 
// Define arrays to store the solar data fetched from EEPROM

float power_gen_jan[] = {};
float power_gen_feb[] = {};
float power_gen_july[] = {};
float power_gen_sep[] = {};
float power_gen_oct[] = {};

//---------------------------------------------------------------------------------------------------------------

float operateModeFlag(float solarPower, int chargeFlag, int dischargeFlag, int errorFlag, float soc_batt){

  dod_batt = 1-soc_batt;
  
  if (solarPower > 0 && soc_batt<=1 && soc_batt>=0.5) {
    chargeFlag = 1;
    dischargeFlag = 0;
    errorFlag = 0;
   } else if(solarPower > 0 && soc_batt>1){
    chargeFlag = 0;
    dischargeFlag = 0;
    errorFlag = 0;
   } else if (solarPower == 0 && dod_batt <= 0.5){
    chargeFlag = 0;
    dischargeFlag = 1;
    errorFlag = 0;
   } else if (solarPower == 0 && dod_batt > 0.5){
    chargeFlag = 0;
    dischargeFlag = 0;
       
   } else {
    chargeFlag = 0;
    dischargeFlag = 0;
    errorFlag = 1;
 }
   return  chargeFlag, dischargeFlag, errorFlag;
}

float chargeCurrCal(float solarPower, float chargeCurr, float v_batt, float soc_batt, int errorFlag){
  if (soc_batt<=0.7&& soc_batt >= 0.8){
  chargeCurr = C1_chargeCurr;
  errorFlag = 0;
  } else if (soc_batt > 0.8 && soc_batt<=1){
     v_batt = 6;
     chargeCurr = solarPower/v_batt;
     errorFlag = 0;
  } else {
    chargeCurr = 0;
    errorFlag = 1;
  }
  return chargeCurr, errorFlag; 
}


float dischargeCurrCal(float dischargeCurr, float v_batt, float soc_batt, int errorFlag){
  dod_batt = 1-soc_batt;
  if (dod_batt>=0&& dod_batt <= 0.2){
    v_batt = 6;
    dischargeCurr = p_lamp/v_batt;
    if (dischargeCurr>dischargeCurr_max){
      dischargeCurr = dischargeCurr_max;
      errorFlag = 0;
    } else if(dod_batt>0.2&& dod_batt <= 0.4){
    v_batt = 0.8*(6);
    dischargeCurr = p_lamp/v_batt;
    errorFlag = 0;
  } else if (dod_batt>0.4&& dod_batt <=0.5){
    v_batt = 0.4*(6);
    dischargeCurr = p_lamp/v_batt;
    errorFlag = 0;
  } else{
    dischargeCurr = 0;
    errorFlag = 1;
  }
   return dischargeCurr, errorFlag;
}
}

//void updateBattStatus(float chargeCurr, float dischargeCurr, int chargeFlag, int dischargeFlag, int errorFlag){
//
//  if (errorFlag != 1){
//    if (chargeFlag == 1 && dischargeFlag ==0){
//       soc_ = v_batt+(chargeCurr);
//  
//}
//} else {
// 
//}
//}
     
void setup()
{
Serial.begin(9600);
   while (!Serial); 
    

  for (int i = 1;i<time_sec_size;i++){
    power_gen_jan[i] = pgm_read_float_near(solar_gen_jan + i);
    power_gen_feb[i] = pgm_read_float_near(solar_gen_feb + i);
    power_gen_july[i] = pgm_read_float_near(solar_gen_july + i);
    power_gen_sep[i] = pgm_read_float_near(solar_gen_sep + i);
    power_gen_oct[i] = pgm_read_float_near(solar_gen_oct + i);
    
         
//    if (pgm_read_float_near(solar_gen_jan + i) < 10){
//      power_gen_jan[i] = 0;
//    } else { 
//      power_gen_jan[i] = pgm_read_float_near(solar_gen_jan + i);
//    }
//    
//    if (abs(pgm_read_float_near(solar_gen_feb + i)) < 10){
//       power_gen_feb[i] = 0;
//    }else{
//       power_gen_feb[i] = abs(pgm_read_float_near(solar_gen_feb + i));
//    }
//     if (abs(pgm_read_float_near(solar_gen_july + i)) < 10){
//      power_gen_july[i] = 0;
//    }else{
//      power_gen_july[i] = abs(pgm_read_float_near(solar_gen_july + i));
//    }
//     if (abs(pgm_read_float_near(solar_gen_sep + i)) < 10){
//      power_gen_sep[i] = 0;
//    } else{
//      power_gen_sep[i]=abs(pgm_read_float_near(solar_gen_sep + i));
//    }
//     if (abs(pgm_read_float_near(solar_gen_jan + i)) < 10){
//      power_gen_oct[i] = 0;
//    }else{
//      power_gen_oct[i] = abs(pgm_read_float_near(solar_gen_jan + i));
//    }
 
 }
 }

  

void loop()
{

   
}   
